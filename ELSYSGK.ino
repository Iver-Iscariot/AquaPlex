#include <SPI.h>
#include <Wire.h>
#include <Adafruit_GFX.h>
#include <Adafruit_SSD1306.h>
#define SCREEN_WIDTH 128 // OLED display width, in pixels
#define SCREEN_HEIGHT 64 // OLED display height, in pixels
#define OLED_RESET     -1 // Reset pin # (or -1 if sharing Arduino reset pin)
#define SCREEN_ADDRESS 0x3C ///< See datasheet for Address; 0x3D for 128x64, 0x3C for 128x32
Adafruit_SSD1306 display(SCREEN_WIDTH, SCREEN_HEIGHT, &Wire, OLED_RESET);

// 'tank', 88x49px
const unsigned char tank [] PROGMEM = {
	0x80, 0x00, 0x00, 0x20, 0x00, 0x00, 0x00, 0x04, 0x00, 0x00, 0x01, 0x80, 0x00, 0x00, 0x20, 0x00, 
	0x00, 0x00, 0x04, 0x00, 0x00, 0x01, 0x80, 0x00, 0x00, 0x20, 0x00, 0x00, 0x00, 0x04, 0x00, 0x00, 
	0x01, 0x40, 0x00, 0x00, 0x40, 0x00, 0x00, 0x00, 0x02, 0x00, 0x00, 0x02, 0x40, 0x00, 0x00, 0x40, 
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	0x00, 0x00, 0x00, 0x00, 0x00, 0x81, 0x00, 0x00, 0x00, 0x00, 0x00
};
// 'tank01', 88x49px
const unsigned char tank01 [] PROGMEM = {
	0x00, 0x00, 0x00, 0x00, 0x00, 0x00, 0x00, 0x00, 0x00, 0x00, 0x00, 0x00, 0x00, 0x00, 0x00, 0x00, 
	0x00, 0x00, 0x01, 0xff, 0xff, 0xfc, 0x00, 0x00, 0x00, 0x00, 0x00, 0x00, 0x00, 0x00, 0xff, 0xff, 
	0xf8, 0x00, 0x00, 0x00, 0x00, 0x00, 0x00, 0x00, 0x00, 0xff, 0xff, 0xf8, 0x00, 0x00, 0x00, 0x00, 
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	0x00, 0x00, 0x00, 0x00, 0x00, 0x00, 0x00, 0x00, 0x00, 0x00, 0x00
};
// 'tank02', 88x49px
const unsigned char tank02 [] PROGMEM = {
	0x00, 0x00, 0x00, 0x00, 0x00, 0x00, 0x00, 0x00, 0x00, 0x00, 0x00, 0x3f, 0xff, 0xff, 0x80, 0x00, 
	0x00, 0x00, 0x00, 0x00, 0x00, 0x00, 0x1f, 0xff, 0xff, 0x00, 0x00, 0x00, 0x00, 0x00, 0x00, 0x00, 
	0x00, 0x1f, 0xff, 0xff, 0x00, 0x00, 0x00, 0x00, 0x00, 0x00, 0x00, 0x00, 0x1f, 0xff, 0xff, 0x00, 
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	0x00, 0x00, 0x00, 0x00, 0x00, 0x00, 0x00, 0x00, 0x00, 0x00, 0x00
};
// 'drain', 88x49px
const unsigned char drain_bmp [] PROGMEM = {
	0x00, 0x00, 0x00, 0x00, 0x00, 0x00, 0x00, 0x00, 0x00, 0x00, 0x00, 0x3f, 0xff, 0xff, 0x80, 0x00, 
	0x00, 0x00, 0x01, 0xff, 0xff, 0xfc, 0x1f, 0xff, 0xff, 0x00, 0x00, 0x00, 0x00, 0x00, 0xff, 0xff, 
	0xf8, 0x1f, 0xff, 0xff, 0x00, 0x00, 0x00, 0x00, 0x00, 0xff, 0xff, 0xf8, 0x1f, 0xff, 0xff, 0x00, 
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	0x00, 0x00, 0x00, 0x00, 0x00, 0x3c, 0x00, 0x00, 0x00, 0x00, 0x00
};
// 'measure', 108x49px
const unsigned char measure [] PROGMEM = {
	0x00, 0x00, 0x00, 0x00, 0x00, 0x00, 0x00, 0x00, 0x00, 0x00, 0x00, 0x00, 0x00, 0x00, 0x3f, 0xff, 
	0xff, 0x80, 0x00, 0x00, 0x00, 0x01, 0xff, 0xff, 0xfc, 0x00, 0x00, 0x00, 0x1f, 0xff, 0xff, 0x00, 
	0x00, 0x00, 0x00, 0x00, 0xff, 0xff, 0xf8, 0x00, 0x00, 0x00, 0x1f, 0xff, 0xff, 0x00, 0x00, 0x00, 
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	0x00, 0x00, 0x00, 0x00, 0x00, 0x00, 0x00, 0x00, 0x00, 0x00, 0x00, 0x00, 0x00, 0x00
};

#define in1 6
#define in2 7
#define out 8

#define com1 A0
#define com2 A1

long startTime = 0;
long drainStartTime = 0;
long onTime = 20000;
long drainOnTime = 25000;

bool physical = true;
bool initialize = true;
bool drain = false;

byte innValves[] = {in1, in2};
int tankIndex = 0;

void setup() {
  display.begin(SSD1306_SWITCHCAPVCC, SCREEN_ADDRESS);
  display.clearDisplay();
  display.setTextSize(2);             // Normal 1:1 pixel scale
  display.setTextColor(SSD1306_WHITE);        // Draw white text
  display.setCursor(0,0);

  Serial.begin(9600);
  pinMode(in1, OUTPUT);
  pinMode(in2, OUTPUT);
  pinMode(out, OUTPUT);

  digitalWrite(in1, HIGH);  // relays are active low, so set high to CLOSE valves at start
  digitalWrite(in2, HIGH);
  digitalWrite(out, HIGH);


  pinMode(com1, OUTPUT);
  pinMode(com2, OUTPUT);

  digitalWrite(com1, LOW);
  digitalWrite(com2, LOW);
}

void draw(){
  display.clearDisplay();
  display.drawBitmap(20, 16, tank, 88, 49, 1);
  if(tankIndex == 0 && drain == false){
    display.setCursor(0, 0);
    display.print("Tapping 01");
    display.drawBitmap(20, 16, tank01, 88, 49, 1);
  }
  if(tankIndex == 1 && drain == false){
    display.setCursor(0, 0);
    display.print("Tapping 02");
    display.drawBitmap(20, 16, tank02, 88, 49, 1);
  }

  if(drain){
    display.setCursor(0, 0);
    display.print("Draining");
    display.drawBitmap(20, 16, drain_bmp, 88, 49, 1);
  }

  display.display();
}


void openValve(){
  //////  valve open  ///////
    //display.clearDisplay();

    
    //display.setTextSize(1);             // Normal 1:1 pixel scale
    //display.setTextColor(SSD1306_WHITE);        // Draw white text
    //display.setCursor(0,0);
    //display.print("opening valve: ");
    Serial.print("opening valve: ");
    if(tankIndex + 1 < 10){Serial.print('0');//display.print('0');
    }
    //display.println(tankIndex + 1);
    Serial.println(tankIndex + 1);

  startTime = millis();
  if(physical){
    digitalWrite(innValves[tankIndex], LOW);
  }
    Serial.print("\tvalve should remain open for ");
    Serial.print(onTime/1000);
    Serial.println('s');
    //display.display();
}

void openDrain(){
  //////  valve open  ///////
  //display.println("Opening drain");
  Serial.println("Opening drain");

  drainStartTime = millis();
  if(physical){
    digitalWrite(out, LOW);
  }
    Serial.print("\tdrain should remain open for ");
    Serial.print(drainOnTime/1000);
    Serial.println('s');
  //display.display();
}

void closeValve(){  
  //display.print("   closing valve: ");
  Serial.print("\tclosing valve: ");
  if(tankIndex + 1 < 10){Serial.print('0');display.print('0');}
  //display.println(tankIndex + 1);
  Serial.print(tankIndex + 1);

  if(physical){
    digitalWrite(innValves[tankIndex], HIGH);
  }

    
  Serial.println();
  Serial.println();
    //display.display();
}

void closeDrain(){
  //display.println("\tclosing drain");
  Serial.println("\tclosing drain");

  if(physical){
    digitalWrite(out, HIGH);
  }

    
  Serial.println();
  Serial.println();
    //display.display();
}

void nextTank(){
  /////// prepare for next tank initialization  /////////
  tankIndex++;
  if(tankIndex > sizeof(innValves)/sizeof(innValves[0])-1){tankIndex = 0;}
  initialize = true;
}


void loop() {
  if(initialize){
    Serial.println("######################################");
    Serial.println("Initializing measure sequence.....");

    openValve();

    initialize = false;
  }

  //////////  valve close, measure, open drain ///////////
  if(millis()-startTime > onTime && drain == false){
    closeValve();

    ////////// insert measure cycle
    display.clearDisplay();
    display.drawBitmap(20,16, tank, 88,49,1);
    display.drawBitmap(20, 16, measure, 108, 49, 1);
    display.setCursor(0, 0);
    display.print("Measure ");
    if(tankIndex + 1 < 10){display.print('0');}
    display.println(tankIndex + 1);
    display.display();
    if(tankIndex == 0){
      digitalWrite(com1, HIGH);
      delay(5000);
      digitalWrite(com1, LOW);      
    }
    else if(tankIndex == 1){
      digitalWrite(com2, HIGH);
      delay(5000);
      digitalWrite(com2, LOW);
    }

    ////// after measure cycle
    drain = true;
    drainStartTime = millis();
    openDrain();

  }

  draw();

if(millis()-drainStartTime > drainOnTime && drain == true){
    closeDrain();
    drain = false;

    nextTank();
  }
}
