#include <SPI.h>
#include <Wire.h>
#include <Adafruit_GFX.h>
#include <Adafruit_SSD1306.h>
#define SCREEN_WIDTH 128 // OLED display width, in pixels
#define SCREEN_HEIGHT 64 // OLED display height, in pixels
#define OLED_RESET     -1 // Reset pin # (or -1 if sharing Arduino reset pin)
#define SCREEN_ADDRESS 0x3C ///< See datasheet for Address; 0x3D for 128x64, 0x3C for 128x32
Adafruit_SSD1306 display(SCREEN_WIDTH, SCREEN_HEIGHT, &Wire, OLED_RESET);

// 'tank', 88x49px
const unsigned char tank [] PROGMEM = {
	0x80, 0x00, 0x00, 0x20, 0x00, 0x00, 0x00, 0x04, 0x00, 0x00, 0x01, 0x80, 0x00, 0x00, 0x20, 0x00, 
	0x00, 0x00, 0x04, 0x00, 0x00, 0x01, 0x80, 0x00, 0x00, 0x20, 0x00, 0x00, 0x00, 0x04, 0x00, 0x00, 
	0x01, 0x40, 0x00, 0x00, 0x40, 0x00, 0x00, 0x00, 0x02, 0x00, 0x00, 0x02, 0x40, 0x00, 0x00, 0x40, 
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	0x00, 0x00, 0x00, 0x00, 0x00, 0x81, 0x00, 0x00, 0x00, 0x00, 0x00
};
// 'tank01', 88x49px
const unsigned char tank01 [] PROGMEM = {
	0x00, 0x00, 0x00, 0x00, 0x00, 0x00, 0x00, 0x00, 0x00, 0x00, 0x00, 0x00, 0x00, 0x00, 0x00, 0x00, 
	0x00, 0x00, 0x01, 0xff, 0xff, 0xfc, 0x00, 0x00, 0x00, 0x00, 0x00, 0x00, 0x00, 0x00, 0xff, 0xff, 
	0xf8, 0x00, 0x00, 0x00, 0x00, 0x00, 0x00, 0x00, 0x00, 0xff, 0xff, 0xf8, 0x00, 0x00, 0x00, 0x00, 
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	0x00, 0x00, 0x00, 0x00, 0x00, 0x00, 0x00, 0x00, 0x00, 0x00, 0x00
};
// 'tank02', 88x49px
const unsigned char tank02 [] PROGMEM = {
	0x00, 0x00, 0x00, 0x00, 0x00, 0x00, 0x00, 0x00, 0x00, 0x00, 0x00, 0x3f, 0xff, 0xff, 0x80, 0x00, 
	0x00, 0x00, 0x00, 0x00, 0x00, 0x00, 0x1f, 0xff, 0xff, 0x00, 0x00, 0x00, 0x00, 0x00, 0x00, 0x00, 
	0x00, 0x1f, 0xff, 0xff, 0x00, 0x00, 0x00, 0x00, 0x00, 0x00, 0x00, 0x00, 0x1f, 0xff, 0xff, 0x00, 
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	0x00, 0x00, 0x00, 0x00, 0x00, 0x00, 0x00, 0x00, 0x00, 0x00, 0x00
};
// 'drain', 88x49px
const unsigned char drain_bmp [] PROGMEM = {
	0x00, 0x00, 0x00, 0x00, 0x00, 0x00, 0x00, 0x00, 0x00, 0x00, 0x00, 0x3f, 0xff, 0xff, 0x80, 0x00, 
	0x00, 0x00, 0x01, 0xff, 0xff, 0xfc, 0x1f, 0xff, 0xff, 0x00, 0x00, 0x00, 0x00, 0x00, 0xff, 0xff, 
	0xf8, 0x1f, 0xff, 0xff, 0x00, 0x00, 0x00, 0x00, 0x00, 0xff, 0xff, 0xf8, 0x1f, 0xff, 0xff, 0x00, 
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	0x00, 0x00, 0x00, 0x00, 0x00, 0x3c, 0x00, 0x00, 0x00, 0x00, 0x00
};
// 'measure', 108x49px
const unsigned char measure [] PROGMEM = {
0x00, 0x00, 0x00, 0x00, 0x00, 0x00, 0x00, 0x00, 0x00, 0x00, 0x00, 0x00, 0x00, 0x00, 0x3f, 0xff, 
	0xff, 0x80, 0x00, 0x00, 0x00, 0x01, 0xff, 0xff, 0xfc, 0x00, 0x00, 0x00, 0x1f, 0xff, 0xff, 0x00, 
	0x00, 0x00, 0x00, 0x00, 0xff, 0xff, 0xf8, 0x00, 0x00, 0x00, 0x1f, 0xff, 0xff, 0x00, 0x00, 0x00, 
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	0x00, 0x00, 0x00, 0x00, 0x00, 0x00, 0x00, 0x00, 0x00, 0x00, 0x00, 0x00, 0x00, 0x00
};

#define in1 6
#define in2 7
#define out 8

#define com1 A0
#define com2 A1

#define but1 A2
#define but2 A3
#define but3 A6
#define but4 A7
#define but5 12

int buttonState1 = 0; 
int buttonState2 = 0; 
int buttonState3 = 0; 
int buttonState4 = 0; 
int buttonState5 = 0; 

long startTime = 0;
long drainStartTime = 0;
long onTime = 20000;
long drainOnTime = 25000;

bool physical = true;
bool initialize = true;
bool drain = false;

byte innValves[] = {in1, in2};
int tankIndex = 0;

void setup() {
  display.begin(SSD1306_SWITCHCAPVCC, SCREEN_ADDRESS);
  display.clearDisplay();
  display.setTextSize(2);             // Normal 1:1 pixel scale
  display.setTextColor(SSD1306_WHITE);        // Draw white text
  display.setCursor(0,0);
  display.print("swag");
  display.display();

  Serial.begin(9600);
  pinMode(in1, OUTPUT);
  pinMode(in2, OUTPUT);
  pinMode(out, OUTPUT);

  digitalWrite(in1, HIGH);  // relays are active low, so set high to CLOSE valves at start
  digitalWrite(in2, HIGH);
  digitalWrite(out, HIGH);


  pinMode(com1, OUTPUT);
  pinMode(com2, OUTPUT);
  
  pinMode(but1, INPUT);
  pinMode(but2, INPUT);
  pinMode(but3, INPUT);
  pinMode(but4, INPUT);
  pinMode(but5, INPUT);

  digitalWrite(com1, LOW);
  digitalWrite(com2, LOW);
}

void draw(){
  display.clearDisplay();
  display.drawBitmap(20, 16, tank, 88, 49, 1);
  if(tankIndex == 0 && drain == false){
    display.setCursor(0, 0);
    display.print("Tapping 01");
    display.drawBitmap(20, 16, tank01, 88, 49, 1);
  }
  if(tankIndex == 1 && drain == false){
    display.setCursor(0, 0);
    display.print("Tapping 02");
    display.drawBitmap(20, 16, tank02, 88, 49, 1);
  }

  if(drain){
    display.setCursor(0, 0);
    display.print("Draining");
    display.drawBitmap(20, 16, drain_bmp, 88, 49, 1);
  }

  display.display();
}

void loop() {
  buttonState1 = analogRead(but1);
  buttonState2 = analogRead(but2);
  buttonState3 = analogRead(but3);
  buttonState4 = analogRead(but4);
  buttonState5 = digitalRead(but5);

  if (buttonState1 > 200){buttonState1 = 1;}else{buttonState1 = 0;}
  if (buttonState2 > 200){buttonState2 = 1;}else{buttonState2 = 0;}
  if (buttonState3 > 200){buttonState3 = 1;}else{buttonState3 = 0;}
  if (buttonState4 > 200){buttonState4 = 1;}else{buttonState4 = 0;}

  if(buttonState1 == LOW && buttonState2 == LOW && buttonState3 == LOW && buttonState4 == LOW && buttonState5 == LOW ){
    display.clearDisplay();
    display.drawBitmap(20, 16, drain_bmp, 88, 49, 1);
    display.fillRect(61, 52, 6, 20, BLACK);
    display.drawFastHLine(60, 57, 7, WHITE);
    display.drawBitmap(20, 16, tank, 88, 49, 1);
    display.display();
  }

  if (buttonState1 == HIGH && buttonState5 == LOW) {
    display.clearDisplay();
    display.setCursor(0, 0);
    display.print("Tapping 02");
    display.drawBitmap(20, 16, tank, 88, 49, 1);
    display.drawBitmap(20, 16, tank02, 88, 49, 1);
    display.display();
    digitalWrite(in2, LOW);
  } else{digitalWrite(in2, HIGH);}

  if (buttonState5 == HIGH && buttonState1 == LOW) {
    display.clearDisplay();
    display.setCursor(0, 0);
    display.print("Tapping 01");
    display.drawBitmap(20, 16, tank, 88, 49, 1);
    display.drawBitmap(20, 16, tank01, 88, 49, 1);
    display.display();
    digitalWrite(in1, LOW);
  } else{digitalWrite(in1, HIGH);}

  if (buttonState3 == HIGH) {
    display.clearDisplay();
    display.setCursor(0, 0);
    display.print("Draining");
    display.drawBitmap(20, 16, tank, 88, 49, 1);
    display.drawBitmap(20, 16, drain_bmp, 88, 49, 1);
    display.display();
    digitalWrite(out, LOW);
  } else{digitalWrite(out, HIGH);}

  if (buttonState2 == HIGH) {
    display.clearDisplay();
    display.setCursor(0, 0);
    display.print("Measure 02");
    display.drawBitmap(20, 16, tank, 88, 49, 1);
    display.drawBitmap(20, 16, measure, 108, 49, 1);
    display.display();
    digitalWrite(com1, HIGH);
    delay(100);
    digitalWrite(com1, LOW);
    delay(100);
  } 
  if (buttonState4 == HIGH) {
    display.clearDisplay();
    display.setCursor(0, 0);
    display.print("Measure 01");
    display.drawBitmap(20, 16, tank, 88, 49, 1);
    display.drawBitmap(20, 16, measure, 108, 49, 1);
    display.display();
    digitalWrite(com2, HIGH);
    delay(100);
    digitalWrite(com2, LOW);
    delay(100);
  } 
}